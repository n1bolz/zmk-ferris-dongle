#include "wellum34.dtsi"

&kscan0 {
	input-gpios
		= <&gpio0 1  (GPIO_ACTIVE_LOW | GPIO_PULL_UP)> // Q
		, <&gpio0 16 (GPIO_ACTIVE_LOW | GPIO_PULL_UP)> // W
		, <&gpio0 15 (GPIO_ACTIVE_LOW | GPIO_PULL_UP)> // E
		, <&gpio0 19 (GPIO_ACTIVE_LOW | GPIO_PULL_UP)> // R
		, <&gpio0 21 (GPIO_ACTIVE_LOW | GPIO_PULL_UP)> // T

		, <&gpio0 2  (GPIO_ACTIVE_LOW | GPIO_PULL_UP)> // A
		, <&gpio0 10 (GPIO_ACTIVE_LOW | GPIO_PULL_UP)> // S
		, <&gpio0 14 (GPIO_ACTIVE_LOW | GPIO_PULL_UP)> // D
		, <&gpio0 18 (GPIO_ACTIVE_LOW | GPIO_PULL_UP)> // F
		, <&gpio0 20 (GPIO_ACTIVE_LOW | GPIO_PULL_UP)> // G

		, <&gpio0 0  (GPIO_ACTIVE_LOW | GPIO_PULL_UP)> // Z
		, <&gpio0 3  (GPIO_ACTIVE_LOW | GPIO_PULL_UP)> // X
		, <&gpio0 9  (GPIO_ACTIVE_LOW | GPIO_PULL_UP)> // C
		, <&gpio0 4  (GPIO_ACTIVE_LOW | GPIO_PULL_UP)> // V
		, <&gpio0 6  (GPIO_ACTIVE_LOW | GPIO_PULL_UP)> // B

		, <&gpio0 7  (GPIO_ACTIVE_LOW | GPIO_PULL_UP)> // SPACE
		, <&gpio0 5  (GPIO_ACTIVE_LOW | GPIO_PULL_UP)> // LA_NAV
		;
};
