## config/boards/shields/wellum34/Kconfig.defconfig
```kconfig
if SHIELD_WELLUM34_DONGLE

config ZMK_KEYBOARD_NAME
	default "Wellum Dongle"

config ZMK_SPLIT_BLE_ROLE_CENTRAL
	default y

config ZMK_USB
	default y

endif

if SHIELD_WELLUM34_LEFT || SHIELD_WELLUM34_RIGHT || SHIELD_WELLUM34_DONGLE

config ZMK_SPLIT
	default y

config ZMK_BLE
	default y

endif
```
